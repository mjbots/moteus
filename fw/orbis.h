// Copyright 2025 mjbots Robotic Systems, LLC.  info@mjbots.com
//
// Licensed under the Apache License, Version 2.0 (the "License");
// you may not use this file except in compliance with the License.
// You may obtain a copy of the License at
//
//     http://www.apache.org/licenses/LICENSE-2.0
//
// Unless required by applicable law or agreed to in writing, software
// distributed under the License is distributed on an "AS IS" BASIS,
// WITHOUT WARRANTIES OR CONDITIONS OF ANY KIND, either express or implied.
// See the License for the specific language governing permissions and
// limitations under the License.

#pragma once

#include "mbed.h"

#include "hal/spi_api.h"

#include "fw/aux_common.h"
#include "fw/ccm.h"
#include "fw/stm32_spi.h"

namespace moteus {

/// Driver for the RLS Orbis 14-bit absolute encoder over SPI.
///
/// Protocol details:
/// - SPI Mode 1 (CPOL=0, CPHA=1)
/// - Clock: 1-2 MHz recommended
/// - CS delay: 2.5us minimum after CS low before transfer
/// - 3-byte continuous read frame returns: Position(14-bit) + Status(2-bit) + CRC
/// - Position extraction: (byte0 << 8 | byte1) >> 2
/// - CRC polynomial: 0x97 (byte 3 is inverted CRC of bytes 0-2)
/// - Resolution: 14-bit (CPR = 16384)
class Orbis {
 public:
  using Options = Stm32Spi::Options;

  Orbis(const Options& options)
      : spi_([&]() {
               auto options_copy = options;
               options_copy.width = 8;
               options_copy.mode = 1;  // CPOL=0, CPHA=1
               // We will manage CS manually
               options_copy.cs = NC;
               return options_copy;
             }()),
        cs_(std::in_place_t(), options.cs, 1) {
  }

  /// Called each ISR cycle - advances state machine.
  /// Returns true when a new position reading is available.
  bool ISR_Update(aux::Spi::Status* status) MOTEUS_CCM_ATTRIBUTE {
    switch (state_) {
      case State::kClearCs: {
        cs_->clear();
        state_ = State::kStartDma;
        return false;
      }
      case State::kStartDma: {
        // CS has been low for one ISR cycle (~33us >> 2.5us requirement)
        spi_.start_dma_transfer(
            std::string_view(reinterpret_cast<const char*>(tx_buffer_), 3),
            mjlib::base::string_span(reinterpret_cast<char*>(rx_buffer_), 3));
        state_ = State::kWaitDma;
        return false;
      }
      case State::kWaitDma: {
        if (!spi_.is_dma_finished()) { return false; }

        spi_.finish_dma_transfer();
        cs_->set();

        // Extract 14-bit position: (byte0 << 8 | byte1) >> 2
        const uint16_t raw = (rx_buffer_[0] << 8) | rx_buffer_[1];
        const uint16_t position = (raw >> 2) & 0x3FFF;

        // Validate CRC
        if (!ValidateCRC()) {
          // Don't set active to false, just leave it as is and don't
          // increment nonce.
          status->checksum_errors++;
          state_ = State::kClearCs;
          return false;
        }

        status->value = position;

        const bool warn = raw & 0x01;
        const bool err = raw & 0x02;

        // We are only active if there are no errors.
        status->active = err;

        status->ic_pz_bits =
            (warn ? 1 : 0) |
            (err ? 2 : 0);

        status->nonce++;
        state_ = State::kClearCs;
        return true;
      }
    }
    return false;
  }

 private:
  enum class State {
    kClearCs,   // Assert CS low
    kStartDma,  // Start DMA transfer
    kWaitDma,   // Poll DMA completion, finish, validate CRC
  };

  // 16-entry lookup table for CRC-8 with polynomial 0x97 (4-bit at a time)
  // Generated by computing CRC for values 0x00-0x0F
  static constexpr uint8_t kCrc8Table[16] = {
    0x00, 0x97, 0xB9, 0x2E, 0xE5, 0x72, 0x5C, 0xCB,
    0x5D, 0xCA, 0xE4, 0x73, 0xB8, 0x2F, 0x01, 0x96,
  };

  bool ValidateCRC() const MOTEUS_CCM_ATTRIBUTE {
    uint8_t crc = 0;
    // Process each byte as two 4-bit nibbles (high nibble first)
    crc = kCrc8Table[(crc >> 4) ^ (rx_buffer_[0] >> 4)] ^ (crc << 4);
    crc = kCrc8Table[(crc >> 4) ^ (rx_buffer_[0] & 0x0F)] ^ (crc << 4);
    crc = kCrc8Table[(crc >> 4) ^ (rx_buffer_[1] >> 4)] ^ (crc << 4);
    crc = kCrc8Table[(crc >> 4) ^ (rx_buffer_[1] & 0x0F)] ^ (crc << 4);
    return (crc ^ 0xFF) == rx_buffer_[2];
  }

  Stm32Spi spi_;
  std::optional<Stm32DigitalOutput> cs_;

  State state_ = State::kClearCs;
  uint8_t tx_buffer_[3] = {0xFF, 0xFF, 0xFF};
  uint8_t rx_buffer_[3] = {};
};

}
